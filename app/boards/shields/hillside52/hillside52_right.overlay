// Overlay file name should match name in Kconfig.shield
#include "hillside52.dtsi" // The shared dtsi file is included in the overlay

&default_transform { // Offset of X because the left side has X columns
    col-offset = <6>;
};

// Label of the kscan node in the dtsi
&kscan0 {
    col-gpios
        = <&pro_micro 10 GPIO_ACTIVE_HIGH> // col5 in the schematic
        , <&pro_micro 16 GPIO_ACTIVE_HIGH> // col4 in the schematic
        , <&pro_micro 14 GPIO_ACTIVE_HIGH> // col3 in the schematic
        , <&pro_micro 15 GPIO_ACTIVE_HIGH> // col2 in the schematic
        , <&pro_micro 18 GPIO_ACTIVE_HIGH> // col1 in the schematic
        , <&pro_micro 19 GPIO_ACTIVE_HIGH> // col0 in the schematic
        ;
};
