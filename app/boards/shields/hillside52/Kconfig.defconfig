## app/boards/shields/hillside52/Kconfig.defconfig
```kconfig
# All copy/pasted from ZMK docs
if SHIELD_HILLSIDE52_LEFT

# Name must be less than 16 characters long!
config ZMK_KEYBOARD_NAME
    default "Hillside52"

config ZMK_SPLIT_ROLE_CENTRAL
    default y

endif

if SHIELD_HILLSIDE52_LEFT || SHIELD_HILLSIDE52_RIGHT

config ZMK_SPLIT
    default y

endif
```

## app/boards/shields/hillside52/Kconfig.shield
```kconfig
# All copy/pasted from ZMK docs
# No whitespace after the comma or in your part name!
config SHIELD_HILLSIDE52_LEFT
    def_bool $(shields_list_contains,hillside52_left)

# No whitespace after the comma or in your part name!
config SHIELD_HILLSIDE52_RIGHT
    def_bool $(shields_list_contains,hillside52_right)
```
